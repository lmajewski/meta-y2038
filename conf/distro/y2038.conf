## conf/distro/y2038.conf
```bitbake
require conf/distro/poky.conf
require y2038.inc

DISTRO = "y2038"
DISTRO_NAME = "Y2038 Glibc Development/Tetsting"
# Do not install pulseaudio
DISTRO_FEATURES_BACKFILL_CONSIDERED = "pulseaudio"
DISTRO_FEATURES:append = " ptest"

PREFERRED_PROVIDER_virtual/kernel:beaglebone-yocto = "linux-yocto"
PREFERRED_VERSION_linux-yocto:beaglebone-yocto = "5.10%"

PREFERRED_PROVIDER_virtual/kernel = "linux-y2038"
PREFERRED_VERSION_linux-y2038 = "5.10%"

#PREFERRED_PROVIDER_virtual/kernel = "linux-lts"
#PREFERRED_VERSION_linux-lts = "4.19%"

# This code is necessary to prevent from following QA error:
# ERROR: perl-5.24.4-r0 do_package_qa: QA Issue: /usr/lib/libperl.so.5.24.4
# contained in package perl-lib requires libcrypt.so.1(XCRYPT_2.0), but no
# providers found in RDEPENDS_perl-lib? [file-rdeps]
#
RDEPENDS_perl-lib += " libxcrypt"
```

## conf/distro/y2038.inc
```bitbake
# Options required to provide Y2038 support

# Kernel 5.1.0+ has 64 bit time related syscalls on 32 bit ports
# e.g. ARMv7
OLDEST_KERNEL = "5.1.0"

# Specify global CFLAGS for target to support 64 bit time
TARGET_CPPFLAGS += "-D_TIME_BITS=64 -D_FILE_OFFSET_BITS=64"
```

## conf/layer.conf
```bitbake
# We have a conf and classes directory, add to BBPATH
BBPATH .= ":${LAYERDIR}"

# We have recipes-* directories, add to BBFILES
BBFILES += "${LAYERDIR}/recipes-*/*/*.bb \
            ${LAYERDIR}/recipes-*/*/*.bbappend"

BBFILE_COLLECTIONS += "meta-y2038"
BBFILE_PATTERN_meta-y2038 = "^${LAYERDIR}/"
BBFILE_PRIORITY_meta-y2038 = "8"

LAYERDEPENDS_meta-y2038 = "core"
LAYERSERIES_COMPAT_meta-y2038 = "thud"
```

## conf/machine/qemux86-64-x32.conf
```bitbake
require conf/machine/qemux86-64.conf

# qemux86_64-x32 is a modification of in-repo qemux86-64.conf machine
# to support x32 ABI
DEFAULTTUNE = "x86-64-x32"

# Let's reuse qemux86-64's code whenever possible
# If y2038x86_64's setup is not present, then look for qemux86-64 one
MACHINEOVERRIDES = "qemuall:qemux86-64:${MACHINE}"

PREFERRED_PROVIDER_virtual/kernel = "linux-y2038"
```

## conf/machine/y2038arm.conf
```bitbake
# y2038 is an extended version of qemuarm machine
# to use arm_vexpress

#@TYPE: Machine
#@NAME: arm_vexpress_a9
#@DESCRIPTION: arm_vexpress_a9

include conf/machine/include/scs.inc
require conf/machine/include/qemu.inc
require conf/machine/include/tune-cortexa9.inc

KERNEL_IMAGETYPE = "zImage"
MACHINE_EXTRA_RRECOMMENDS = " kernel-modules kernel-devicetree"
KERNEL_DEVICETREE = "vexpress-v2p-ca9.dtb"

SERIAL_CONSOLES ?= "115200;ttyAMA0"

# Set proper alignment - here 4MiB, to make quest mmcblk layer happy
# when running ext4 image in qemu
IMAGE_ROOTFS_ALIGNMENT = "4096"

# For runqemu
QB_MEM = "-m 512"
QB_SYSTEM_NAME = "qemu-system-arm"
QB_MACHINE = "-machine vexpress-a9 -smp 2"
QB_KERNEL_CMDLINE_APPEND = "console=ttyAMA0,115200"

QB_DTB = "zImage-vexpress-v2p-ca9.dtb"
QB_OPT_APPEND = "-nographic"
QB_KERNEL_ROOT = "/dev/mmcblk0 rootwait"
QB_AUDIO_DRV = "none"
QB_SLIRP_OPT = " "
QB_ROOTFS_OPT = "-drive file=@ROOTFS@,if=sd,format=raw,readonly=off"
QB_TAP_OPT = "-netdev tap,id=net0,ifname=@TAP@,script=no,downscript=no"
QB_NETWORK_DEVICE = "-net nic,model=lan9118,netdev=net0,macaddr=@MAC@"
QB_SERIAL_OPT = " "


PREFERRED_VERSION_linux-y2038_y2038arm = "5.0%"
PREFERRED_PROVIDER_virtual/kernel_y2038arm = "linux-y2038"

#PREFERRED_VERSION_linux-y2038_y2038arm = "4.19%"
#PREFERRED_PROVIDER_virtual/kernel_y2038arm = "linux-lts"

# Reuse as much as possible from default 'qemuall' MACHINE
# Especially the *.cfg files for virtualization
MACHINEOVERRIDES_append = ":qemuall"
```
